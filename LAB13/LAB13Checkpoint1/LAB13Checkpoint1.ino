#include <avr/io.h>           //เรียกใช้คลังโปรแกรม io.h
#include <avr/interrupt.h>    //เรียกใช้คลังโปรแกรมสำหรับขัดจังหวะ
#include "my_twi.h"           //เรียกใช้คลังโปรแกรมจัดการมอดูลทีดับเบิลยูไอ
#include "my_pcf8574.h"       //เรียกใช้คลังโปรแกรมจัดการไอซี PCF8574
                              //---ส่วนบิตอื่นที่เหลือเป็นเอาต์พุต
uint8_t count;                //ตั้งค่าตัวแปรส่วนกลาง (global variable)
unsigned long last_time;    

uint8_t prepare_data(uint8_t d)
{
  uint8_t tmp;
  tmp = ~d;                   //กลับทุกบิตเป็นตรงข้ามเนื่องจาก LED เป็น Common A
  tmp |= 0x80;                //เขียนค่ารหัสขับแอลอีดีโดยไม่ให้มีผล                               
  return tmp;                 //--กระทบต่อบิต MSB ที่ใช้เป็นอินพุต 
}

void setup()
{
  last_time =0;  
  Serial.begin(9600);
  uint8_t tmp, i;             //ประกาศตัวแปร tmp และตัวแปร i ขนาด 8 บิต
  init_twi_module();          //สั่งให้มอดูลทีดับเบิลยูไอเริ่มทำงาน
  count = 0;                  //สั่งให้ตัวแปร count มีค่าเริ่มต้นเท่ากับศูนย์  
  tmp = prepare_data(count);  
  PCF8574_write(0, tmp);      
}                             //จบการทำงานของฟังก์ชันหลัก

void loop(){

  uint8_t tmp;

  tmp = PCF8574_read(0);
  tmp &= 0x80;      //กรองบิต
  if(!tmp)          //ตรวจสอบว่ามีการกดปุ่มของสวิตช์หรือไม่
  {
    if( millis() - last_time > 20) 
    //ตรวจสอบว่าค่าเวลาในปัจจุบันมีระยะห่างจากครั้งก่อนหน้าอยู่ 20ms หรือไม่
    {
      last_time = millis(); //ให้ตัวแปร last_time เก็บค่าเวลาก่อนหน้าในรูปแบบมิลลิวินาที
      tmp = PCF8574_read(0);
      tmp &= 0x80;
      if (!tmp)   //หากพบว่ามีการกดปุ่มของสวิตช์
      {
        Serial.println("Keypressed detected");
        count < 127 ? count++ : count = 0;    
        //ตรวจสอบว่าค่าในตัวแปร count มีค่าน้อยกว่า 127 หรือไม่ 
        //ถ้าใช่ให้เพิ่มค่าในตัวแปร count ขึ้นหนึ่งค่า (แอลอีดีเพิ่มขึ้นหนึ่งค่าทุกครั้งที่มีการกดสวิตช์)
        //ถ้าไม่ใช่ให้ค่าในตัวแปร count เท่ากับ 0 (แอลอีดีจะดับทุกดวงใหม่อีกครั้ง)
      }
      do
      {
        tmp = PCF8574_read(0);  //อ่านสถานะทางตรรกะจากพอร์ตของ PCF8574
        tmp &= 0x80;
      }
      while(!tmp);    
    }
  }
  tmp = prepare_data(count);  //ส่งข้อมูลจาก count ไปเก็บไว้ในตัวแปร tmp
  PCF8574_write(0, tmp);      //นำค่าที่เก็บไว้ในตัวแปร tmp ไปแสดงผล
}

