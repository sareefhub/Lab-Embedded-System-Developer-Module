#include <avr/io.h>
#include <avr/interrupt.h>

// ข้อความที่ต้องการส่ง
unsigned char TEXT[13] = "Hello world\r\n";
unsigned char i;

// ฟังก์ชันสำหรับส่งข้อมูลผ่าน USART
void USART_Transmit(unsigned char data)
{
  while (!(UCSR0A & (1<<UDRE0))); // รอจนกว่าบัฟเฟอร์การส่งข้อมูลจะว่าง
  UDR0 = data; // ใส่ข้อมูลลงในบัฟเฟอร์การส่งข้อมูล
}

// ฟังก์ชันสำหรับรับข้อมูลจาก USART
unsigned char USART_Receive(void)
{
  while (!(UCSR0A & (1<<RXC0))); // รอจนกว่ามีข้อมูลมาถึง
  return UDR0; // รับข้อมูลจากบัฟเฟอร์การรับข้อมูล
}

int main(void)
{
  // การตั้งค่า USART
  UCSR0A = 0x00; // ตั้งค่าพื้นฐานสำหรับการควบคุม USART
  UCSR0B = 0x18; // เปิดใช้งานการส่งข้อมูลและการรับข้อมูล
  UCSR0C = 0x06; // ตั้งค่ารูปแบบข้อมูล: 8 บิตข้อมูล, 1 บิตหยุด
  UBRR0H = 0; // ตั้งค่า UBRR0H (ส่วนของตัวหารสูง)
  UBRR0L = 103; // ตั้งค่า UBRR0L (ตัวหารต่ำ) เพื่อกำหนด Baud Rate เป็น 9600

  // ส่งข้อความ "Hello world" ไปยังคอมพิวเตอร์
  for (i = 0; i < 13; i++) 
  {
    USART_Transmit(TEXT[i]); // ส่งข้อมูลทีละตัวอักษร
  }

  while (1)
  {
    // รับข้อมูลจากคอมพิวเตอร์
    i = USART_Receive(); // รับข้อมูลจากบัฟเฟอร์การรับข้อมูล
    i += 2; // เพิ่มค่า 2 ให้กับข้อมูลที่รับมา
    // ส่งข้อมูลที่ปรับค่าแล้วกลับไปยังคอมพิวเตอร์
    USART_Transmit(i); // ส่งข้อมูลที่ปรับค่าแล้ว
  }

  return 0; // โปรแกรมจะไม่ถึงจุดนี้เนื่องจากอยู่ในลูปไม่สิ้นสุด
}
